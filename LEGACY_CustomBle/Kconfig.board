## LEGACY_CustomBle/Kconfig.board
```kconfig
# Thingy52 NRF52832 board configuration

# Copyright (c) 2018 Aapo Vienamo
# SPDX-License-Identifier: Apache-2.0

config BOARD_CustomBle
	bool "CustomBle"
	select GPIO
	depends on SOC_NRF52832_QFAA
```

## LEGACY_CustomBle/Kconfig.defconfig
```kconfig
# Thingy52 NRF52832 board configuration

# Copyright (c) 2018 Aapo Vienamo
# SPDX-License-Identifier: Apache-2.0

if BOARD_CustomBle

config BOARD
	default "CustomBle"

config I2C
	default y

config BT_CTLR
	default BT

endif # BOARD_CustomBle
```

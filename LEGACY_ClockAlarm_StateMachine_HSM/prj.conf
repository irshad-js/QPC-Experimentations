## CMakeLists.txt
```
# SPDX-License-Identifier: Apache-2.0

cmake_minimum_required(VERSION 3.20.0)

find_package(Zephyr REQUIRED HINTS $ENV{ZEPHYR_BASE})
project(hello_world)

target_sources(app PRIVATE src/main.c)

target_sources(app PRIVATE src/main.c)
target_sources(app PRIVATE src/qepn.c)
target_sources(app PRIVATE src/ClockAlarm_SM.c)
target_sources(app PRIVATE src/csrc/mui.c)
target_sources(app PRIVATE src/csrc/mui_u8g2.c)
target_sources(app PRIVATE src/csrc/u8g2_bitmap.c)
target_sources(app PRIVATE src/csrc/u8g2_box.c)
target_sources(app PRIVATE src/csrc/u8g2_buffer.c)
target_sources(app PRIVATE src/csrc/u8g2_button.c)
target_sources(app PRIVATE src/csrc/u8g2_circle.c)
target_sources(app PRIVATE src/csrc/u8g2_cleardisplay.c)
target_sources(app PRIVATE src/csrc/u8g2_d_memory.c)
target_sources(app PRIVATE src/csrc/u8g2_d_setup.c)
target_sources(app PRIVATE src/csrc/u8g2_font.c)
target_sources(app PRIVATE src/csrc/u8g2_fonts.c)
target_sources(app PRIVATE src/csrc/u8g2_hvline.c)
target_sources(app PRIVATE src/csrc/u8g2_input_value.c)
target_sources(app PRIVATE src/csrc/u8g2_intersection.c)
target_sources(app PRIVATE src/csrc/u8g2_kerning.c)
target_sources(app PRIVATE src/csrc/u8g2_line.c)
target_sources(app PRIVATE src/csrc/u8g2_ll_hvline.c)
target_sources(app PRIVATE src/csrc/u8g2_message.c)
target_sources(app PRIVATE src/csrc/u8g2_polygon.c)
target_sources(app PRIVATE src/csrc/u8g2_selection_list.c)
target_sources(app PRIVATE src/csrc/u8g2_setup.c)
target_sources(app PRIVATE src/csrc/u8log.c)
target_sources(app PRIVATE src/csrc/u8log_u8g2.c)
target_sources(app PRIVATE src/csrc/u8log_u8x8.c)
target_sources(app PRIVATE src/csrc/u8x8_8x8.c)
target_sources(app PRIVATE src/csrc/u8x8_byte.c)
target_sources(app PRIVATE src/csrc/u8x8_cad.c)
target_sources(app PRIVATE src/csrc/u8x8_capture.c)
target_sources(app PRIVATE src/csrc/u8x8_d_a2printer.c)
target_sources(app PRIVATE src/csrc/u8x8_d_gu800.c)
target_sources(app PRIVATE src/csrc/u8x8_d_st7565.c)
target_sources(app PRIVATE src/csrc/u8x8_debounce.c)
target_sources(app PRIVATE src/csrc/u8x8_display.c)
target_sources(app PRIVATE src/csrc/u8x8_fonts.c)
target_sources(app PRIVATE src/csrc/u8x8_gpio.c)
target_sources(app PRIVATE src/csrc/u8x8_input_value.c)
target_sources(app PRIVATE src/csrc/u8x8_message.c)
target_sources(app PRIVATE src/csrc/u8x8_selection_list.c)
target_sources(app PRIVATE src/csrc/u8x8_setup.c)
target_sources(app PRIVATE src/csrc/u8x8_string.c)
target_sources(app PRIVATE src/csrc/u8x8_u16toa.c)
target_sources(app PRIVATE src/csrc/u8x8_u8toa.c)
```

## prj.conf
```kconfig
CONFIG_DEBUG_OPTIMIZATIONS=y
CONFIG_DEBUG_THREAD_INFO=y
```

## src/main.c
```c
/*
 * Copyright (c) 2012-2014 Wind River Systems, Inc.
 *
 * SPDX-License-Identifier: Apache-2.0
 */

#include <zephyr.h>
#include <sys/printk.h>
#include <drivers/gpio.h>
#include "csrc/u8g2.h"
#include <drivers/spi.h>
#include <time.h>
#include <hal/nrf_gpio.h>
#include<stdio.h>
#include "qpn.h"
#include "ClockAlarm_SM.h"



extern u8g2_t u8g2; // a structure which will contain all the data for one display

Q_DEFINE_THIS_FILE;

uint8_t* SPiTxPointer ;
uint32_t milliSecondCounter;

void InitializeSPI(void);
void DisplayInit(void);

void ScanRotaryEncoder(void);

const struct device *gpio0;

uint8_t u8x8_byte_hw_spi(u8x8_t *u8x8, uint8_t msg, uint8_t arg_int, void *arg_ptr);
uint8_t u8x8_gpio_and_delay(U8X8_UNUSED u8x8_t *u8x8,U8X8_UNUSED uint8_t msg, U8X8_UNUSED uint8_t arg_int,U8X8_UNUSED void *arg_ptr);

#define SPIM_SCK_PIN 26
#define SPIM_MOSI_PIN 27
#define SPIM_MISO_PIN 28
#define SPIM_CSN_PIN 29
#define DC_PIN 30
#define RESET_PIN 31
#define Rotary_Clk 2
#define Rotary_Data 3
#define Rotary_Button 12

int Counter;  
int CurrentState;
int LastState;

Q_NORETURN Q_onAssert(char_t const * const module, int_t const loc) {
    /*
    * NOTE: add here your application-specific error handling
    */
    (void)module;
    (void)loc;
}


void main(void){

  gpio0 = device_get_binding("GPIO_0");
  gpio_pin_configure(gpio0, 30, GPIO_OUTPUT);
  gpio_pin_configure(gpio0, 31, GPIO_OUTPUT);
  gpio_pin_configure(gpio0, Rotary_Clk, GPIO_INPUT);
  gpio_pin_configure(gpio0, Rotary_Data, GPIO_INPUT);
  gpio_pin_configure(gpio0, Rotary_Button, GPIO_INPUT | (GPIO_ACTIVE_HIGH | GPIO_PULL_UP));

  LastState = gpio_pin_get(gpio0,Rotary_Clk);

  InitializeSPI();

  DisplayInit();

  Clock_Alarm_Constructor();  
  QHSM_INIT(SuperClass_Qhsm_Clock);

  struct k_timer milliSecondInterrupt;
  k_timer_init(&milliSecondInterrupt,MilliSecondInterrupt_Cb,NULL);
  k_timer_start(&milliSecondInterrupt,K_USEC(1000),K_USEC(1000));

  while (1){

  ScanRotaryEncoder();

  if (milliSecondCounter >= 1000){
    Q_SIG(SuperClass_Qhsm_Clock) = TICK_SIG;
    QHSM_DISPATCH(SuperClass_Qhsm_Clock);
    milliSecondCounter = 0;
   }
   else if ( (milliSecondCounter%500) == 1)
   {
    Q_SIG(SuperClass_Qhsm_Clock) = ALARM_SIG;
    QHSM_DISPATCH(SuperClass_Qhsm_Clock);
   }
  }
}

void ScanRotaryEncoder(void){

  int Button = gpio_pin_get(gpio0,Rotary_Button);

  if (Button == 0){
    Q_SIG(SuperClass_Qhsm_Clock) = OK_SIG;
    QHSM_DISPATCH(SuperClass_Qhsm_Clock);
   }

  CurrentState =  gpio_pin_get(gpio0,Rotary_Clk);

  if(CurrentState != LastState){

    int TempState = gpio_pin_get(gpio0,Rotary_Data);

    if (TempState != CurrentState){
      Q_SIG(SuperClass_Qhsm_Clock) = SET_SIG; 
      QHSM_DISPATCH(SuperClass_Qhsm_Clock);
    }
     else {
      Q_SIG(SuperClass_Qhsm_Clock) = OK_SIG;
      QHSM_DISPATCH(SuperClass_Qhsm_Clock);
     }
  }
  LastState = CurrentState;
}

void DisplayInit(void){
	u8g2_Setup_st7565_zolen_128x64_1(&u8g2, U8G2_MIRROR, u8x8_byte_hw_spi, u8x8_gpio_and_delay);  
  u8g2_InitDisplay(&u8g2);
  u8g2_SetPowerSave(&u8g2, 0);
  u8g2_SetFont(&u8g2, u8g2_font_ncenB14_tr);
  u8g2_SetDrawColor(&u8g2,1);
}

void InitializeSPI(void){

    NRF_GPIO->OUTCLR = 1UL << SPIM_SCK_PIN;

    NRF_GPIO->PIN_CNF[SPIM_SCK_PIN] = (uint32_t) NRF_GPIO_PIN_DIR_OUTPUT << GPIO_PIN_CNF_DIR_Pos
            | (uint32_t) NRF_GPIO_PIN_INPUT_CONNECT << GPIO_PIN_CNF_INPUT_Pos
            | (uint32_t) NRF_GPIO_PIN_NOPULL << GPIO_PIN_CNF_PULL_Pos
            | (uint32_t) NRF_GPIO_PIN_S0S1 << GPIO_PIN_CNF_DRIVE_Pos
            | (uint32_t) NRF_GPIO_PIN_NOSENSE << GPIO_PIN_CNF_SENSE_Pos;
    
    NRF_SPIM1->PSEL.SCK = SPIM_SCK_PIN;

    NRF_GPIO->OUTCLR = 1UL << SPIM_MOSI_PIN;
    
    NRF_GPIO->PIN_CNF[SPIM_MOSI_PIN] =
            (uint32_t) NRF_GPIO_PIN_DIR_OUTPUT << GPIO_PIN_CNF_DIR_Pos
            | (uint32_t) NRF_GPIO_PIN_INPUT_DISCONNECT << GPIO_PIN_CNF_INPUT_Pos
            | (uint32_t) NRF_GPIO_PIN_NOPULL << GPIO_PIN_CNF_PULL_Pos
            | (uint32_t) NRF_GPIO_PIN_S0S1 << GPIO_PIN_CNF_DRIVE_Pos
            | (uint32_t) NRF_GPIO_PIN_NOSENSE << GPIO_PIN_CNF_SENSE_Pos;
    
    NRF_SPIM1->PSEL.MOSI = SPIM_MOSI_PIN;

    NRF_GPIO->PIN_CNF[SPIM_MISO_PIN] =
            (uint32_t) NRF_GPIO_PIN_DIR_INPUT << GPIO_PIN_CNF_DIR_Pos
            | (uint32_t) NRF_GPIO_PIN_INPUT_CONNECT << GPIO_PIN_CNF_INPUT_Pos
            | (uint32_t) NRF_GPIO_PIN_NOPULL << GPIO_PIN_CNF_PULL_Pos
            | (uint32_t) NRF_GPIO_PIN_S0S1 << GPIO_PIN_CNF_DRIVE_Pos
            | (uint32_t) NRF_GPIO_PIN_NOSENSE << GPIO_PIN_CNF_SENSE_Pos;
    
    NRF_SPIM1->PSEL.MISO = SPIM_MISO_PIN;

    NRF_GPIO->OUTSET = 1UL << SPIM_CSN_PIN;
    
    NRF_GPIO->PIN_CNF[SPIM_CSN_PIN] =
            (uint32_t) NRF_GPIO_PIN_DIR_OUTPUT << GPIO_PIN_CNF_DIR_Pos
            | (uint32_t) NRF_GPIO_PIN_INPUT_DISCONNECT << GPIO_PIN_CNF_INPUT_Pos
            | (uint32_t) NRF_GPIO_PIN_NOPULL << GPIO_PIN_CNF_PULL_Pos
            | (uint32_t) NRF_GPIO_PIN_S0S1 << GPIO_PIN_CNF_DRIVE_Pos
            | (uint32_t) NRF_GPIO_PIN_NOSENSE << GPIO_PIN_CNF_SENSE_Pos;

    NRF_SPIM1->CONFIG = 0; // CPOL = 0 - ActiveHigh, CPHA = 0 - Leading edge, ByteOrder = 0 - MSB  
    NRF_SPIM1->ORC = 0x55;
    NRF_SPIM1->FREQUENCY = SPIM_FREQUENCY_FREQUENCY_M8;
    NRF_SPIM1->ENABLE = SPIM_ENABLE_ENABLE_Enabled;

}


void SPI_TX_Data(uint8_t* data){

  SPiTxPointer = data;

  NRF_SPIM1->TXD.MAXCNT = 1;
  NRF_SPIM1->TXD.PTR = &SPiTxPointer;
  NRF_GPIO->OUTCLR = 1UL << SPIM_CSN_PIN;
  NRF_SPIM1->TASKS_START = 1;
	while(NRF_SPIM1->EVENTS_ENDTX != 1 ){

	}
  NRF_SPIM1->EVENTS_ENDTX = 0;
  NRF_SPIM1->TASKS_STOP = 1;
  NRF_GPIO->OUTSET = 1UL << SPIM_CSN_PIN;
}


uint8_t u8x8_byte_hw_spi(u8x8_t *u8x8, uint8_t msg, uint8_t arg_int, void *arg_ptr) {

  uint8_t *data;
  
  switch(msg) {
  
    case U8X8_MSG_BYTE_SEND:
      data = (uint8_t *)arg_ptr;
      while( arg_int > 0 ) {
        SPI_TX_Data((uint8_t)*data);
        data++;
        arg_int--;
      }  
      break;
  
    case U8X8_MSG_BYTE_SET_DC:
      if(arg_int==0){
        gpio_pin_set(gpio0,DC_PIN,0);
      }else 
        gpio_pin_set(gpio0,DC_PIN,1);
      
      break;

    default:return 0;
  }  
  return 1;
}

uint8_t u8x8_gpio_and_delay(U8X8_UNUSED u8x8_t *u8x8,U8X8_UNUSED uint8_t msg, U8X8_UNUSED uint8_t arg_int,U8X8_UNUSED void *arg_ptr){

  switch (msg){

    case U8X8_MSG_GPIO_AND_DELAY_INIT:
      k_msleep(1);
      break;
    
    case U8X8_MSG_DELAY_MILLI:
      k_msleep(arg_int);
      break;
    
    case U8X8_MSG_GPIO_DC:
      if(arg_int==0){
        gpio_pin_set(gpio0,DC_PIN,0);
      }else gpio_pin_set(gpio0,DC_PIN,1);
      
      break;
    
    case U8X8_MSG_GPIO_RESET:  
      if(arg_int==0){
        gpio_pin_set(gpio0,RESET_PIN,0);
      }else gpio_pin_set(gpio0,RESET_PIN,1);
      
      break;
  
  }
  return 1;
}


#if 0


void RefreshDisplay(char * Buffer,int64_t Custom){

  char m_str[3];

  strcpy(m_str, u8x8_u8toa(m, 2));		/* convert m to a string with two digits */

  u8g2_FirstPage(&u8g2);

  do {

    u8g2_SetFont(&u8g2,u8g2_font_logisoso62_tn);

    u8g2_DrawStr(&u8g2,0,63,"9");

    u8g2_DrawStr(&u8g2,33,63,":");

    u8g2_DrawStr(&u8g2,50,63,m_str);

  } while ( u8g2_NextPage(&u8g2) );

  k_msleep(1000);

  m++;

  if ( m == 60 )

    m = 0;

}

    //u8g2_DrawStr(&u8g2,2,16,"State - Clock");

    //u8g2_DrawStr(&u8g2,0+Offset,16+Offset,m_str);

    //u8g2_DrawStr(&u8g2,24+Offset,16+Offset,"-");

    //u8g2_DrawStr(&u8g2,30+Offset,16+Offset,m_str);

    //u8g2_DrawStr(&u8g2,54+Offset,16+Offset,"-");

    //u8g2_DrawStr(&u8g2,60+Offset,16+Offset,m_str);


#endif
```

## src/ClockAlarm_SM.h
```c
/*.$file${HSM::../src::ClockAlarm_SM.h} vvvvvvvvvvvvvvvvvvvvvvvvvvvvvvvvvvvv*/
/*
* Model: StateMachine_ClockAlarm.qm
* File:  ${HSM::../src::ClockAlarm_SM.h}
*
* This code has been generated by QM 5.1.1 <www.state-machine.com/qm/>.
* DO NOT EDIT THIS FILE MANUALLY. All your changes will be lost.
*
* This program is open source software: you can redistribute it and/or
* modify it under the terms of the GNU General Public License as published
* by the Free Software Foundation.
*
* This program is distributed in the hope that it will be useful, but
* WITHOUT ANY WARRANTY; without even the implied warranty of MERCHANTABILITY
* or FITNESS FOR A PARTICULAR PURPOSE. See the GNU General Public License
* for more details.
*/
/*.$endhead${HSM::../src::ClockAlarm_SM.h} ^^^^^^^^^^^^^^^^^^^^^^^^^^^^^^^^^*/
#ifndef CLOCK_H
#define CLOCK_H
#include "qpn.h"
#include "csrc/u8g2.h"
#include<kernel.h>
#include <stdio.h>

#define SecondsInDay 86400000
#define INITIAL_CURRENT_TIME (13UL*60UL*60UL*1000UL)+(45*60*1000)+(45*1000)
#define INITIAL_ALARM_TIME (13UL*60UL*60UL*1000UL)+(46*60*1000)+(00*1000)

enum ClockAlarm_Signals{
    SET_SIG= Q_USER_SIG,
    OK_SIG,
    ALARM_SIG,
    TICK_SIG,
    MAX_SIG

};

enum Alarm_Status{
    ALARM_OFF,
    ALARM_ON
};

/*.$declare${HSM::SuperClass_Qhsm_Clock} vvvvvvvvvvvvvvvvvvvvvvvvvvvvvvvvvvv*/
extern QHsm * const SuperClass_Qhsm_Clock;
/*.$enddecl${HSM::SuperClass_Qhsm_Clock} ^^^^^^^^^^^^^^^^^^^^^^^^^^^^^^^^^^^*/
/*.$declare${HSM::Clock_Alarm_Constructor} vvvvvvvvvvvvvvvvvvvvvvvvvvvvvvvvv*/
/*.${HSM::Clock_Alarm_Constructor} .........................................*/
void Clock_Alarm_Constructor(void);
/*.$enddecl${HSM::Clock_Alarm_Constructor} ^^^^^^^^^^^^^^^^^^^^^^^^^^^^^^^^^*/

extern uint32_t milliSecondCounter;

void MilliSecondInterrupt_Cb(struct k_timer * Handle);

void RefreshDisplay(char * FirstLine,char * SecondLine,char * ThirdLine);

#define Offset 20

#endif
```
